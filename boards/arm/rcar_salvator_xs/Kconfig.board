## boards/arm/rcar_salvator_xs/Kconfig.board
```kconfig
# Copyright (c) 2020 Volodymyr Babchuk <volodymyr.babchuk@epam.com>
# SPDX-License-Identifier: Apache-2.0

config BOARD_RCAR_SALVATOR_XS
	bool "Renesas SALVATOR_XS"
	depends on SOC_R8A7795_A72
	select ARM64
```

## boards/arm/rcar_salvator_xs/Kconfig.defconfig
```kconfig
# Copyright (c) 2020 Volodymyr Babchuk <volodymyr.babchuk@epam.com>
# SPDX-License-Identifier: Apache-2.0

if BOARD_RCAR_SALVATOR_XS

config BUILD_OUTPUT_BIN
	default y

config BOARD
	default "rcar_salvator_xs"

endif # BOARD_RCAR_SALVATOR_XS
```

## boards/arm/rcar_salvator_xs/rcar_salvator_xs_defconfig
```kconfig
CONFIG_SOC_R8A7795_A72=y
CONFIG_BOARD_RCAR_SALVATOR_XS=y
CONFIG_ARM_ARCH_TIMER=y

# Enable UART driver
CONFIG_SERIAL=y

CONFIG_SRAM_BASE_ADDRESS=0x48080000
CONFIG_SRAM_SIZE=16384
CONFIG_XIP=n
CONFIG_FLASH_BASE_ADDRESS=0x0
CONFIG_FLASH_SIZE=0

CONFIG_MAX_XLAT_TABLES=20

# Enable console
CONFIG_CONSOLE=y
CONFIG_UART_CONSOLE=y

# Enable serial port
CONFIG_UART_SCIF=y
CONFIG_UART_INTERRUPT_DRIVEN=y

# Enable clock control
CONFIG_CLOCK_CONTROL=y
CONFIG_CLOCK_CONTROL_RCAR_CPG=y

# Enable TMU
CONFIG_COUNTER=y
CONFIG_COUNTER_RCAR_TMU=y
```

## drivers/clock_control/Kconfig.rcar_cpg
```kconfig
# Renesas Rcar Clock Pulse Generator Driver configuration options

# Copyright (c) 2020 EPAM Systems
# SPDX-License-Identifier: Apache-2.0

config CLOCK_CONTROL_RCAR_CPG
	bool "RCAR CPG driver"
	depends on SOC_R8A7795_A72
	help
	  Renesas Rcar Clock Pulse Generator driver.
```

## drivers/counter/Kconfig.rcar_tmu
```kconfig
# Copyright (c) 2020 EPAM Systems
# SPDX-License-Identifier: Apache-2.0

config COUNTER_RCAR_TMU
	bool "Renesas RCAR TMU"
	help
	  Enable support for the Renesas RCAR Timer Module Unit.
```

## drivers/serial/Kconfig.scif
```kconfig
# Copyright (c) 2020 EPAM Systems
# SPDX-License-Identifier: Apache-2.0

config UART_SCIF
	bool "Renesas SCIF UART Driver"
	select SERIAL_HAS_DRIVER
	select SERIAL_SUPPORT_INTERRUPT
	help
	  This option enables the UART driver for the SCIF
```

## dts/bindings/clock/renesas,r8a7795-cpg-mssr.yaml
```yaml
description: RCAR Clock Power Reset controller

compatible: "renesas,r8a7795-cpg-mssr"

include: [clock-controller.yaml, base.yaml]

properties:
    reg:
      required: true

    "#clock-cells":
      const: 2

clock-cells:
  - mode
  - id
```

## dts/bindings/counter/renesas,tmu.yaml
```yaml
# Copyright (c) 2020 Seagate Technology LLC
# SPDX-License-Identifier: Apache-2.0

description: Renesas TMU

compatible: "renesas,tmu"

include: [ base.yaml]

properties:
    reg:
      required: true

    label:
      required: true

    interrupts:
      required: true

    clocks:
      required: false
```

## samples/rt_eval/Kconfig
```kconfig
# Copyright (c) 2020 EPAM Systems
# SPDX-License-Identifier: Apache-2.0

source "Kconfig.zephyr"
```

## soc/arm/rcar_gen3/Kconfig.defconfig
```kconfig
# Copyright 2020 EPAM Systems
# SPDX-License-Identifier: Apache-2.0

if SOC_R8A7795_A72

config SOC
	default "rcar_gen3"

config NUM_IRQS
	int
	default 240

config SYS_CLOCK_HW_CYCLES_PER_SEC
	int
	default 8300000

endif
```

## soc/arm/rcar_gen3/Kconfig.soc
```kconfig
# Copyright 2020 Broadcom
# SPDX-License-Identifier: Apache-2.0

config SOC_R8A7795_A72
	bool "Renesas H3 A72"
	select ARM
	select ARM64
	select CPU_CORTEX_A72
	select ARM_ARCH_TIMER
	select GIC_V2
```
