/*
 * Copyright (c) 2019 Carlo Caione <ccaione@baylibre.com>
 *
 * SPDX-License-Identifier: Apache-2.0
 *
 */

/dts-v1/;
#include <arm/renesas/r8a7795.dtsi>

/ {
	model = "Salvator XS 4GB";

	chosen {
		zephyr,console = &scif2;
		zephyr,shell-uart = &scif2;
	};
};

&scif2 {
	status = "okay";
};

&tmu {
	status = "okay";
};
